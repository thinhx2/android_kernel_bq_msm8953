## drivers/power/Kconfig
```kconfig
config CHARGER_BQ2560X
	tristate "TI BQ2560X battery charger support"
	depends on I2C
	help
	  Say Y to enable support for the TI BQ2560X battery charger.

config BQ27426_FG
	tristate "TI SN274088 fuel gauge driver"
	depends on I2C
	help
	  Say Y to enable support for TI SN274088 gauge driver.

config USB_TEMP_PROTECT
	bool "To switch charging by usb temperature"
	help
	 Say Y here if we want to use this function

source "drivers/power/avs/Kconfig"
source "drivers/power/reset/Kconfig"
source "drivers/power/supply/Kconfig"
source "drivers/power/qcom/Kconfig"
```
